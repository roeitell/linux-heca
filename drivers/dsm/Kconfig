## drivers/dsm/Kconfig
```kconfig
config DSM
	tristate "DSM"
	depends on NUMA && RDS && INFINIBAND && INFINIBAND_ADDR_TRANS && INET && MMU_NOTIFIER && MMU
	default m
	help
	  Enable DSM - running single VM over several linux hosts with qemu/kvm.


		
config DSM_DEBUG
	bool "DSM_DEBUG"
	depends on DSM
	default n
	help
		DSM_DEBUG provides debug functionality for DSM 
		
config DSM_VERBOSE_PRINTK
	bool "DSM_VERBOSE_PRINTK"
	depends on DSM
	default n
	help
		DSM_VERBOSE_PRINTK provide verbose functionality 	
```

## drivers/heca/Kconfig
```kconfig
config HECA
	tristate "HECA"
	depends on NUMA && RDS && INFINIBAND && INFINIBAND_ADDR_TRANS && INET && MMU_NOTIFIER && MMU
	default m
	help
	  Enable HECA - running single VM over several linux hosts with qemu/kvm.

config HECA_DEBUG
	bool "HECA_DEBUG"
	depends on HECA
	default n
	help
		HECA_DEBUG provides debug functionality for HECA 
		
config HECA_VERBOSE_PRINTK
	bool "HECA_VERBOSE_PRINTK"
	depends on HECA
	default n
	help
		HECA_VERBOSE_PRINTK provide verbose functionality 	
```

## drivers/softiwarp/Kconfig
```kconfig
config SOFTIWARP
	tristate "SOFTIWARP"
	depends on RDS && INFINIBAND && INFINIBAND_ADDR_TRANS && INET
	default m
	help
	  Enable Softiwarp : provide software Iwarp over soft tcp / ip stack 

	  
```
